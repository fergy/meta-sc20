## conf/layer.conf
```bitbake
# We might have a conf and classes directory, append to BBPATH
BBPATH .= ":${LAYERDIR}"

# We have a recipes directory, add to BBFILES
BBFILES += "${LAYERDIR}/recipes*/*/*.bb ${LAYERDIR}/recipes*/*/*.bbappend"

BBFILE_COLLECTIONS += "meta-sc20"
BBFILE_PATTERN_meta-sc20 := "^${LAYERDIR}/"
BBFILE_PRIORITY_meta-sc20 = "8"
LAYERSERIES_COMPAT_meta-sc20 = "sumo"
```

## conf/machine/sc20.conf
```bitbake
#@TYPE: Machine
#@NAME: Quectel-sc20
#@DESCRIPTION: Machine configuration for the SC20 development board, with Qualcomm Snapdragon 210 APQ8909.

require conf/machine/include/tune-cortexa7.inc

PREFERRED_PROVIDER_virtual/xserver ?= "xserver-xorg"

XSERVER ?= "xserver-xorg \
            mesa-driver-swrast \
            xf86-input-evdev \
            xf86-input-mouse \
            xf86-video-modesetting \
            xf86-input-keyboard"

MACHINE_FEATURES = "usbhost usbgadget touchscreen bluetooth 3g alsa screen wifi bluetooth"

#PREFERRED_PROVIDER_virtual/kernel ?= "linux-96boards"
PREFERRED_PROVIDER_virtual/kernel ?= "linux-dummy"

KERNEL_IMAGETYPE = "Image"
# Fix me
KERNEL_DEVICETREE = ""

SERIAL_CONSOLE = "115200 ttyAMA0"

# Fastboot expects an ext4 image
IMAGE_FSTYPES_append = " ext4.gz"
```
